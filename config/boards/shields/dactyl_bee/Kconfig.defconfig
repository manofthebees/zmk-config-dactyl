## config/boards/shields/dactyl_bee/Kconfig.defconfig
```kconfig
if SHIELD_DACTYL_BEE_LEFT
 
config ZMK_KEYBOARD_NAME
    default "4x6 dactyl_bee"
 
config ZMK_SPLIT_ROLE_CENTRAL
    default y
 
endif
 
if SHIELD_DACTYL_BEE_LEFT || SHIELD_DACTYL_BEE_RIGHT
 
config ZMK_SPLIT
    default y
 
endif
```

## config/boards/shields/dactyl_bee/Kconfig.shield
```kconfig
config SHIELD_DACTYL_BEE_LEFT
    def_bool $(shields_list_contains,dactyl_bee_left)
    select SHIELD_DACTYL_BEE

config SHIELD_DACTYL_BEE_RIGHT
    def_bool $(shields_list_contains,dactyl_bee_right)
    select SHIELD_DACTYL_BEE
```
